## firmware/AGV-RemoteControl/components/network/Kconfig
```kconfig
menu "rosserial"

    config ROSSERVER_AP
        string "WiFi SSID"
        default "myssid"
        help
            SSID (Access point name) of WiFi to connect

    config ROSSERVER_PASS
        string "WiFi Password"
        default "mypass"
        help
            Password of the WiFi

    config ROSSERVER_IP
        string "IP address of ROS server (roscore)"
        default "192.168.0.1"
        help
            IP address of machine which is running rosserial server

    config ROSSERVER_PORT
        int "Port number of ROS server"
        default 11411
        help
            Port number of rosserial server
            Port number is printed on terminal running rosserial_python

endmenu
```
